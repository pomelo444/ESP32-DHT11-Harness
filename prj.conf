## CMakeLists.txt
```
cmake_minimum_required(VERSION 3.20.0)
find_package(Zephyr REQUIRED HINTS $ENV{ZEPHYR_BASE})
project(esp32_dht11_harness)

target_sources(app PRIVATE src/main.c src/json_report.c)
target_include_directories(app PRIVATE src)
```

## west.yml
```
manifest:
  version: "0.13"
  projects:
    - name: zephyr
      url: https://github.com/zephyrproject-rtos/zephyr
      revision: v4.4.2
      # Resolve Zephyr's pinned module manifest after fetching this project.
      import: true
  self:
    # Default for west init -m; west init -l records the actual checkout path.
    path: app
```

## prj.conf
```kconfig
CONFIG_GPIO=y
CONFIG_SENSOR=y
CONFIG_DHT=y
CONFIG_SERIAL=y
CONFIG_CONSOLE=y
CONFIG_UART_CONSOLE=y
CONFIG_LOG=n
CONFIG_MAIN_STACK_SIZE=2048
```

## app.overlay
```dts
#include <zephyr/dt-bindings/gpio/gpio.h>

/ {
    aliases {
        dht0 = &dht11_sensor;
    };

    dht11_sensor: dht11_sensor {
        compatible = "aosong,dht";
        dio-gpios = <&gpio0 18 (GPIO_ACTIVE_HIGH | GPIO_PULL_UP)>;
        status = "okay";
    };
};
```

## src/main.c
```c
#include <zephyr/kernel.h>
#include <zephyr/device.h>
#include <zephyr/devicetree.h>
#include <zephyr/drivers/sensor.h>
#include <zephyr/drivers/uart.h>
#include <zephyr/sys/atomic.h>
#include <errno.h>
#include <stdint.h>

#include "json_report.h"

#if !DT_NODE_EXISTS(DT_ALIAS(dht0))
#error "Missing dht0 devicetree alias; see app.overlay"
#endif
#if !DT_NODE_EXISTS(DT_CHOSEN(zephyr_console))
#error "No zephyr,console device is selected"
#endif

#define SAMPLE_PERIOD_MS 3000
#define JSON_BUFFER_SIZE 256

static const struct device *const dht_device = DEVICE_DT_GET(DT_ALIAS(dht0));
static const struct device *const console_uart = DEVICE_DT_GET(DT_CHOSEN(zephyr_console));

K_MSGQ_DEFINE(reading_queue, sizeof(struct sensor_reading), 8, 4);
static atomic_t dropped_messages = ATOMIC_INIT(0);

static void read_sensor(struct sensor_reading *reading)
{
    struct sensor_value temperature;
    struct sensor_value humidity;
    int err;

    if (!device_is_ready(dht_device)) {
        reading->error_code = -ENODEV;
        return;
    }
    err = sensor_sample_fetch(dht_device);
    if (err == 0) {
        err = sensor_channel_get(dht_device, SENSOR_CHAN_AMBIENT_TEMP,
                                 &temperature);
    }
    if (err == 0) {
        err = sensor_channel_get(dht_device, SENSOR_CHAN_HUMIDITY, &humidity);
    }
    if (err != 0) {
        reading->error_code = err;
        return;
    }

    reading->temperature_milli = (int32_t)sensor_value_to_milli(&temperature);
    reading->humidity_milli = (int32_t)sensor_value_to_milli(&humidity);
    reading->valid = true;
    reading->error_code = 0;
}

static void sensor_thread(void *arg1, void *arg2, void *arg3)
{
    uint32_t seq = 0;
    (void)arg1;
    (void)arg2;
    (void)arg3;

    while (true) {
        struct sensor_reading reading = {0};
        reading.seq = ++seq;
        reading.uptime_ms = k_uptime_get_32();
        read_sensor(&reading);

        if (k_msgq_put(&reading_queue, &reading, K_NO_WAIT) != 0) {
            atomic_inc(&dropped_messages);
        }
        k_sleep(K_MSEC(SAMPLE_PERIOD_MS));
    }
}

static void output_line(const char *data, int count)
{
    for (int index = 0; index < count; ++index) {
        uart_poll_out(console_uart, (unsigned char)data[index]);
    }
    uart_poll_out(console_uart, '\r');
    uart_poll_out(console_uart, '\n');
}

static void output_thread(void *arg1, void *arg2, void *arg3)
{
    char line[JSON_BUFFER_SIZE];
    (void)arg1;
    (void)arg2;
    (void)arg3;

    if (!device_is_ready(console_uart)) {
        return;
    }
    while (true) {
        struct sensor_reading reading;
        if (k_msgq_get(&reading_queue, &reading, K_FOREVER) != 0) {
            continue;
        }
        int size = json_report_format(line, sizeof(line), &reading);
        if (size > 0) {
            output_line(line, size);
        }
    }
}

K_THREAD_DEFINE(sensor_thread_id, 2048, sensor_thread, NULL, NULL, NULL, 5, 0, 0);
K_THREAD_DEFINE(output_thread_id, 2048, output_thread, NULL, NULL, NULL, 5, 0, 0);

int main(void)
{
    /* The two statically declared threads do the work. */
    return 0;
}
```

## src/json_report.c
```c
#include "json_report.h"

#include <errno.h>
#include <stdint.h>

struct json_writer {
    char *buf;
    size_t cap;
    size_t len;
    bool ok;
};

static void append_char(struct json_writer *w, char ch)
{
    if (!w->ok) {
        return;
    }
    if (w->len + 1U >= w->cap) {
        w->ok = false;
        return;
    }
    w->buf[w->len++] = ch;
    w->buf[w->len] = '\0';
}

static void append_str(struct json_writer *w, const char *text)
{
    while (*text != '\0' && w->ok) {
        append_char(w, *text++);
    }
}

static void append_uint64(struct json_writer *w, uint64_t number)
{
    char digits[20];
    size_t n = 0;

    do {
        digits[n++] = (char)('0' + (number % 10U));
        number /= 10U;
    } while (number != 0U);

    while (n > 0U) {
        append_char(w, digits[--n]);
    }
}

static void append_int32(struct json_writer *w, int32_t number)
{
    int64_t promoted = number;
    if (promoted < 0) {
        append_char(w, '-');
        promoted = -promoted;
    }
    append_uint64(w, (uint64_t)promoted);
}

/* Rounds milli-units to two decimal places without floating point/printf. */
static void append_milli2(struct json_writer *w, int32_t value_milli)
{
    int64_t scaled = value_milli;
    uint64_t positive_centi;

    if (scaled < 0) {
        append_char(w, '-');
        scaled = -scaled;
    }
    positive_centi = (uint64_t)((scaled + 5) / 10);
    append_uint64(w, positive_centi / 100U);
    append_char(w, '.');
    append_char(w, (char)('0' + ((positive_centi / 10U) % 10U)));
    append_char(w, (char)('0' + (positive_centi % 10U)));
}

int json_report_format(char *buffer, size_t capacity,
                       const struct sensor_reading *reading)
{
    struct json_writer writer;

    if (buffer == NULL || reading == NULL || capacity == 0U) {
        return -EINVAL;
    }
    buffer[0] = '\0';
    if (reading->valid && reading->error_code != 0) {
        return -EINVAL;
    }
    if (!reading->valid && reading->error_code == 0) {
        return -EINVAL;
    }

    writer.buf = buffer;
    writer.cap = capacity;
    writer.len = 0;
    writer.ok = true;

    append_str(&writer, "{\"device\":\"ESP32-DHT11\",\"seq\":");
    append_uint64(&writer, reading->seq);
    append_str(&writer, ",\"uptime_ms\":");
    append_uint64(&writer, reading->uptime_ms);
    append_str(&writer, ",\"temperature\":");
    if (reading->valid) {
        append_milli2(&writer, reading->temperature_milli);
    } else {
        append_str(&writer, "null");
    }
    append_str(&writer, ",\"temperature_unit\":\"C\",\"humidity\":");
    if (reading->valid) {
        append_milli2(&writer, reading->humidity_milli);
    } else {
        append_str(&writer, "null");
    }
    append_str(&writer, ",\"humidity_unit\":\"%RH\",\"status\":\"");
    append_str(&writer, reading->valid ? "OK" : "ERROR");
    append_str(&writer, "\",\"error_code\":");
    append_int32(&writer, reading->error_code);
    append_char(&writer, '}');

    if (!writer.ok) {
        buffer[0] = '\0';
        return -ENOSPC;
    }
    return (int)writer.len;
}
```

## src/json_report.h
```c
#ifndef JSON_REPORT_H_
#define JSON_REPORT_H_

#include <stdbool.h>
#include <stddef.h>
#include <stdint.h>

/* Values are in 0.001 C and 0.001 %RH, respectively. */
struct sensor_reading {
    uint32_t seq;
    uint32_t uptime_ms;
    int32_t temperature_milli;
    int32_t humidity_milli;
    bool valid;
    int32_t error_code;
};

/* Returns number of bytes excluding NUL or -EINVAL / -ENOSPC. */
int json_report_format(char *buffer, size_t capacity,
                       const struct sensor_reading *reading);

#endif
```
